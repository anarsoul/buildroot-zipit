## package/echinus/Config.in
```kconfig
config BR2_PACKAGE_ECHINUS
	bool "echinus wm"
	depends on BR2_PACKAGE_XLIB_LIBX11
	depends on BR2_PACKAGE_XLIB_LIBXRANDR
	depends on BR2_PACKAGE_LIBXCB
	help
	  echinus is a simple and lightweight tiling and floating
	  window manager for X11.
```

## package/games/fceu/Config.in
```kconfig
config BR2_PACKAGE_FCEU
	bool "fceu"
	select BR2_PACKAGE_SDL
	select BR2_PACKAGE_ZLIB
```

## package/games/fceux/Config.in
```kconfig
config BR2_PACKAGE_FCEUX
       bool "fceux"
       help
         A portable Famicom/NES emulator, an evolution of the original FCE Ultra
	 http://fceux.com
```

## package/games/freedroid/Config.in
```kconfig
config BR2_PACKAGE_FREEDROID
	bool "FreeDroid"
	select BR2_PACKAGE_SDL
	select BR2_PACKAGE_SDL_MIXER
	select BR2_PACKAGE_SDL_IMAGE
	select BR2_PACKAGE_TREMOR
	help
	  A free clone of the C64-classic "Paradroid"
```

## package/games/scummvm/Config.in
```kconfig
config BR2_PACKAGE_SCUMMVM
	bool "ScummVM"
	select BR2_PACKAGE_SDL
	select BR2_PACKAGE_LIBMPEG2
	select BR2_PACKAGE_ALSA_LIB
	select BR2_PACKAGE_LIBMAD
	select BR2_PACKAGE_TREMOR
	select BR2_PACKAGE_ZLIB
	help
	  Reimplementation of the SCUMM game engine used in Lucasarts adventures
	  http://scummvm.sourceforge.net/
```

## package/games/snes9x-sdl/Config.in
```kconfig
config BR2_PACKAGE_SNES9X_SDL
	bool "snes9x-sdl"
	select BR2_PACKAGE_SDL
	select BR2_PACKAGE_ZLIB
	help
	  Super Nintendo Emulator based on SDL
```

## package/irssi/Config.in
```kconfig
config BR2_PACKAGE_IRSSI
	select BR2_PACKAGE_OPENSSL
	select BR2_PACKAGE_NCURSES
	select BR2_PACKAGE_LIBGLIB2
	bool "irssi"
```

## package/minicom/Config.in
```kconfig
config BR2_PACKAGE_MINICOM
	bool "minicom"
	depends on BR2_PACKAGE_NCURSES
	help
```

## package/mouse-emul/Config.in
```kconfig
config BR2_PACKAGE_MOUSE_EMUL
       bool "mouse-emul"
       help
         Tiny mouse emulator
	 https://github.com/anarsoul/mouse-emul
```

## package/multimedia/gmu/Config.in
```kconfig
config BR2_PACKAGE_GMU
       bool "gmu"
       select BR2_PACKAGE_SDL
       select BR2_PACKAGE_SDL_GFX
       select BR2_PACKAGE_SDL_IMAGE
       select BR2_PACKAGE_MPG123
       select BR2_PACKAGE_TREMOR
       select BR2_PACKAGE_FLAC
       select BR2_PACKAGE_SPEEX
```

## package/multimedia/ncmpc/Config.in
```kconfig
config BR2_PACKAGE_NCMPC
	bool "ncmpc"
    select BR2_PACKAGE_NCURSES
    select BR2_PACKAGE_LIBGLIB2
    select BR2_PACKAGE_LIBMPDCLIENT
```

## package/netsurf/Config.in
```kconfig
menu "NetSurf itself and its libs"
source "package/netsurf/libparserutils/Config.in"
source "package/netsurf/hubbub/Config.in"
source "package/netsurf/libwapcaplet/Config.in"
source "package/netsurf/libcss/Config.in"
source "package/netsurf/libnsfb/Config.in"
source "package/netsurf/libnsgif/Config.in"
source "package/netsurf/libnsbmp/Config.in"
source "package/netsurf/netsurf/Config.in"
endmenu
```

## package/netsurf/hubbub/Config.in
```kconfig
config BR2_PACKAGE_HUBBUB
       bool "hubbub"
       select BR2_PACKAGE_LIBPARSERUTILS
```

## package/netsurf/libcss/Config.in
```kconfig
config BR2_PACKAGE_LIBCSS
       bool "libcss"
       select BR2_PACKAGE_LIBWAPCAPLET
       select BR2_PACKAGE_LIBPARSERUTILS
```

## package/netsurf/netsurf/Config.in
```kconfig
config BR2_PACKAGE_NETSURF
       bool "netsurf"
       select BR2_PACKAGE_HUBBUB
       select BR2_PACKAGE_LIBCSS
       select BR2_PACKAGE_LIBNSFB
       select BR2_PACKAGE_LIBNSGIF
       select BR2_PACKAGE_LIBNSBMP
       select BR2_PACKAGE_LIBCURL
       select BR2_PACKAGE_JPEG
       select BR2_PACKAGE_OPENSSL
       select BR2_PACKAGE_LIBXML2
       select BR2_PACKAGE_FREETYPE
       select BR2_PACKAGE_LIBERATION
```
